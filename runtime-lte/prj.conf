## CMakeLists.txt
```
cmake_minimum_required(VERSION 3.20.0)
find_package(Zephyr REQUIRED HINTS $ENV{ZEPHYR_BASE})
project(runtime_lte)

# Only used when runtime-zephyr is built from source (blob rebuild, issue #4).
zephyr_include_directories(compat)

target_sources(app PRIVATE src/main.c src/app_workload.c)
```

## sysbuild.conf
```
SB_CONFIG_BOOTLOADER_MCUBOOT=y
SB_CONFIG_BOOT_SIGNATURE_KEY_FILE="${APPLICATION_CONFIG_DIR}/sysbuild/mcuboot/mcuboot_priv.pem"
```

## prj.conf
```kconfig
# --- nRF9151 / nuSIM LTE ---
CONFIG_BOOTLOADER_MCUBOOT=y
CONFIG_LTE_LINK_CONTROL=y
CONFIG_NRF_MODEM_LIB=y

# --- zbus (required by the monitor's `depends on`) ---
CONFIG_ZBUS=y
CONFIG_ZBUS_MSG_SUBSCRIBER=y
CONFIG_ZBUS_MSG_SUBSCRIBER_BUF_ALLOC_STATIC=y
CONFIG_ZBUS_MSG_SUBSCRIBER_NET_BUF_POOL_SIZE=8
CONFIG_ZBUS_MSG_SUBSCRIBER_NET_BUF_STATIC_DATA_SIZE=192

# --- Runtime security monitor: built-in policies only (no LLEXT/syscall hooks) ---
# Feature set + tunables below are frozen into the blob (README: "Rebuilding the blob").
CONFIG_RUNTIME_MONITOR=y
# platform.exein.io /zephyr/threats accepts only heap_low today; any other
# finding (heap_drop, stack_low, log, ...) gets the whole batch rejected with
# 400 "unsupported finding". Re-enable once the platform takes them.
CONFIG_POLICY_HEAP_LOW=y
CONFIG_POLICY_P2=n
CONFIG_POLICY_STACK_LOW=n
CONFIG_POLICY_LOG=n
CONFIG_THREAD_COLLECT_PERIOD_MS=2000
# Analyzer drains the heap event buffer every second; 5000 ms with a small
# buffer drops FREE events and wedges the HEAP_LOW live-bytes tally.
CONFIG_ANALYZER_PERIOD_MS=1000
CONFIG_MONITOR_EVENT_BUF_SIZE=16384
# The heap listener bridges alloc/free hooks through heap_msgq, drained every
# 500 ms. Default depth 16 silently drops any >16-event burst (Button 2 does
# 24 allocs + 24 frees); a dropped FREE permanently inflates the HEAP_LOW tally.
CONFIG_HEAP_MSGQ_DEPTH=512
# HEAP_LOW threshold: 60% of CONFIG_HEAP_MEM_POOL_SIZE (9831 B of 16 KB).
CONFIG_HEAP_LOW_PCT=60
CONFIG_THREAD_RUNTIME_STATS=y

# --- Exein platform over LTE (runtime_monitor_ncs.conf, modem TLS path) ---
# TLS runs in the modem; CA + client identity live in the modem key store
# (credential backend in main.c). No bootstrap token is built in: it comes
# from the settings page (web flasher or scripts/settings-hex.py).
CONFIG_THREAT_HTTP_DEST_ADDR="platform.exein.io"
CONFIG_THREAT_HTTP_PORT=8003
CONFIG_RUNTIME_MONITOR_REGISTRATION_ADDR="platform.exein.io"
CONFIG_RUNTIME_MONITOR_REGISTRATION_PORT=8004
# AT commands on the log UART (AT%XICCID health check, AT%CMNG to reset the identity).
CONFIG_AT_HOST_LIBRARY=y
CONFIG_UART_INTERRUPT_DRIVEN=y
CONFIG_NET_SOCKETS_SOCKOPT_TLS=n
CONFIG_RUNTIME_MONITOR_TLS=y
CONFIG_TLS_CREDENTIALS=y
CONFIG_MODEM_KEY_MGMT=y
CONFIG_RUNTIME_MONITOR_STACK_OVERFLOW=n
CONFIG_TFM_PARTITION_INTERNAL_TRUSTED_STORAGE=y
# The monitor waits for IPv4 via conn_mgr: needs the modem's Zephyr net_if.
CONFIG_NETWORKING=y
CONFIG_NET_SOCKETS=y
CONFIG_NET_IPV4=y
CONFIG_NET_IPV6=n
# Wall clock for the monitor (compat/zephyr/sys/clock.h on Zephyr 4.1).
CONFIG_POSIX_TIMERS=y
CONFIG_NET_CONNECTION_MANAGER=y
CONFIG_NRF_MODEM_LIB_NET_IF=y
# nuSIM LTE-M attach takes ~30 s; the 30 s default makes the monitor skip
# registration. Read by RUNTIME_ZEPHYR_CONNECTION_INIT (app side, not the blob).
CONFIG_RUNTIME_MONITOR_NET_CONNECT_TIMEOUT=180

# --- Settings page (web flasher or scripts/settings-hex.py; start of the unused MCUboot secondary slot) ---
CONFIG_FLASH=y
CONFIG_FLASH_MAP=y

# --- Custom id nRF9151-DK_<device id> in SystemInfo (main.c) ---
CONFIG_HWINFO=y

# --- Button 2 triggers the heap burst; LED1 shows LTE state ---
CONFIG_GPIO=y

# --- Resources ---
CONFIG_HEAP_MEM_POOL_SIZE=16384
CONFIG_MAIN_STACK_SIZE=8192

# --- Logging (UART) ---
CONFIG_LOG=y
CONFIG_LOG_DEFAULT_LEVEL=3
CONFIG_RUNTIME_MONITOR_LOG_LEVEL_DBG=y
CONFIG_UART_CONSOLE=y
CONFIG_LOG_BACKEND_UART=y
# Default 1 KB buffer drops lines at boot (monitor debug hex dumps).
CONFIG_LOG_BUFFER_SIZE=8192
```

## src/main.c
```c
/*
 * Exein Runtime Security Monitor on the nRF9151 DK.
 *
 * Runs the monitor (precompiled runtime-zephyr blob) with its built-in
 * heap/stack/leak/log policies beside a button-driven demo workload (see
 * app_workload.c). The monitor registers with the Exein platform over LTE and
 * posts incidents there; TLS runs in the modem, credentials live in the
 * modem's key store under SEC_TAG.
 */

#include <errno.h>
#include <string.h>
#include <zephyr/kernel.h>
#include <zephyr/logging/log.h>
#include <zephyr/drivers/gpio.h>
#include <zephyr/drivers/hwinfo.h>
#include <zephyr/net/conn_mgr_connectivity.h>
#include <zephyr/net/conn_mgr_monitor.h>
#include <zephyr/net/net_mgmt.h>
#include <zephyr/storage/flash_map.h>
#include <pm_config.h>
#include <modem/nrf_modem_lib.h>
#include <modem/lte_lc.h>
#include <modem/modem_key_mgmt.h>

#include <runtime_zephyr.h>
#include "app_workload.h"

LOG_MODULE_REGISTER(runtime_lte, LOG_LEVEL_INF);

/* ponytail: fixed modem sec_tag, make it a Kconfig if another app shares the modem. */
#define SEC_TAG 4242

/* Modem key-store writes need LTE off (CFUN=0 at boot, CFUN=4 later). */
static int write_cred(enum modem_key_mgmt_cred_type type, const uint8_t *buf, size_t len)
{
	return modem_key_mgmt_write(SEC_TAG, type, buf, len);
}

static int install_ca(const uint8_t *pem, size_t len)
{
	/* cmp() returns 0 when the stored CA equals pem. */
	if (modem_key_mgmt_cmp(SEC_TAG, MODEM_KEY_MGMT_CRED_TYPE_CA_CHAIN, pem, len) == 0) {
		return 0;
	}
	return write_cred(MODEM_KEY_MGMT_CRED_TYPE_CA_CHAIN, pem, len);
}

static int install_identity(const uint8_t *cert, size_t cert_len,
			    const uint8_t *key, size_t key_len)
{
	int rc = lte_lc_func_mode_set(LTE_LC_FUNC_MODE_OFFLINE);

	if (rc == 0) {
		rc = write_cred(MODEM_KEY_MGMT_CRED_TYPE_PUBLIC_CERT, cert, cert_len);
	}
	if (rc == 0) {
		rc = write_cred(MODEM_KEY_MGMT_CRED_TYPE_PRIVATE_CERT, key, key_len);
	}
	/* Back online either way; the net_if reconnects (connection persistence). */
	int rc2 = lte_lc_func_mode_set(LTE_LC_FUNC_MODE_NORMAL);

	return rc ? rc : rc2;
}

static bool has_identity(void)
{
	bool exists = false;

	(void)modem_key_mgmt_exists(SEC_TAG, MODEM_KEY_MGMT_CRED_TYPE_PRIVATE_CERT, &exists);
	return exists;
}

/* LTE status on LED1: blinking = no IPv4 connectivity, solid = connected.
 * (The nRF9151 DK LEDs are all green, so blink vs solid is the signal.)
 */
static const struct gpio_dt_spec lte_led = GPIO_DT_SPEC_GET(DT_ALIAS(led0), gpios);
static atomic_t lte_up;

static void lte_led_blink(struct k_work *work)
{
	if (atomic_get(&lte_up)) {
		gpio_pin_set_dt(&lte_led, 1);
		return;
	}
	gpio_pin_toggle_dt(&lte_led);
	k_work_schedule(k_work_delayable_from_work(work), K_MSEC(250));
}
static K_WORK_DELAYABLE_DEFINE(lte_led_work, lte_led_blink);

/* net_mgmt events are 64-bit since Zephyr 5a9a39caf3b (v4.2.0), 32-bit
 * before (NCS v3.1); NET_MGMT_MAX_COMMANDS came with that change.
 */
#ifdef NET_MGMT_MAX_COMMANDS
typedef uint64_t mgmt_event_t;
#else
typedef uint32_t mgmt_event_t;
#endif

static void l4_handler(struct net_mgmt_event_callback *cb, mgmt_event_t event,
		       struct net_if *iface)
{
	atomic_set(&lte_up, event == NET_EVENT_L4_IPV4_CONNECTED);
	k_work_reschedule(&lte_led_work, K_NO_WAIT);
}
static struct net_mgmt_event_callback l4_cb;

static void lte_led_init(void)
{
	if (gpio_pin_configure_dt(&lte_led, GPIO_OUTPUT_INACTIVE)) {
		return;
	}
	net_mgmt_init_event_callback(&l4_cb, l4_handler,
				     NET_EVENT_L4_IPV4_CONNECTED | NET_EVENT_L4_DISCONNECTED);
	net_mgmt_add_event_callback(&l4_cb);
	k_work_schedule(&lte_led_work, K_NO_WAIT);
}

/* Settings page (web flasher or scripts/settings-hex.py): a 4 KB page at the start of the
 * (unused) MCUboot secondary slot. The signed app image can't carry them
 * (MCUboot checks the signature on boot). Layout: "EXEINCFG", then three
 * NUL-terminated strings, each empty = keep the build's value:
 *   token      bootstrap token, used for one registration attempt and then
 *              cleared (the platform consumes a token even when the device
 *              fails to read the reply)
 *   custom id  SystemInfo custom_id (default nRF9151-DK_<device id>)
 *   host       platform host for registration (:8004) and telemetry (:8003)
 */
#define CFG_MAGIC "EXEINCFG"
#define CFG_MAGIC_LEN (sizeof(CFG_MAGIC) - 1)

static struct {
	char token[RUNTIME_ZEPHYR_TOKEN_MAX + 1];
	char custom_id[RUNTIME_ZEPHYR_CUSTOM_ID_MAX + 1];
	char host[RUNTIME_ZEPHYR_HOST_MAX + 1];
} cfg;

static const struct flash_area *cfg_area(void)
{
	const struct flash_area *fa;

	return flash_area_open(PM_MCUBOOT_SECONDARY_ID, &fa) ? NULL : fa;
}

/* Copies the next NUL-terminated string of buf[*off..len) into out. */
static int cfg_field(const char *buf, size_t len, size_t *off, char *out, size_t out_size)
{
	size_t n = strnlen(buf + *off, len - *off);

	if (n >= out_size || *off + n >= len) {
		return -EINVAL;
	}
	memcpy(out, buf + *off, n + 1);
	*off += n + 1;
	return 0;
}

/* 1 = settings loaded, 0 = no settings page, < 0 = error. */
static int read_cfg(void)
{
	const struct flash_area *fa = cfg_area();
	char buf[CFG_MAGIC_LEN + sizeof(cfg)];
	size_t off = CFG_MAGIC_LEN;

	if (fa == NULL || flash_area_read(fa, 0, buf, sizeof(buf))) {
		return -EIO;
	}
	if (memcmp(buf, CFG_MAGIC, CFG_MAGIC_LEN) != 0) {
		return 0;
	}
	if (cfg_field(buf, sizeof(buf), &off, cfg.token, sizeof(cfg.token)) ||
	    cfg_field(buf, sizeof(buf), &off, cfg.custom_id, sizeof(cfg.custom_id)) ||
	    cfg_field(buf, sizeof(buf), &off, cfg.host, sizeof(cfg.host))) {
		memset(&cfg, 0, sizeof(cfg));
		return -EINVAL;
	}
	return 1;
}

/* Rewrites the page without the token; custom id and host stay. */
static void clear_cfg_token(void)
{
	const struct flash_area *fa = cfg_area();
	uint8_t buf[ROUND_UP(CFG_MAGIC_LEN + sizeof(cfg), 4)];
	size_t off = CFG_MAGIC_LEN + 1; /* magic + empty token */

	memset(cfg.token, 0, sizeof(cfg.token));
	memset(buf, 0xff, sizeof(buf));
	memcpy(buf, CFG_MAGIC, CFG_MAGIC_LEN);
	buf[CFG_MAGIC_LEN] = '\0';
	strcpy((char *)buf + off, cfg.custom_id);
	off += strlen(cfg.custom_id) + 1;
	strcpy((char *)buf + off, cfg.host);
	off += strlen(cfg.host) + 1;
	if (fa == NULL || flash_area_erase(fa, 0, 4096) ||
	    flash_area_write(fa, 0, buf, ROUND_UP(off, 4))) {
		LOG_ERR("could not clear the token from the settings page");
	}
}

static const struct runtime_zephyr_cred_backend creds = {
	.install_ca = install_ca,
	.install_identity = install_identity,
	.has_identity = has_identity,
};

int main(void)
{
	k_thread_name_set(k_current_get(), "main");
	LOG_INF("Exein Runtime Monitor — nRF9151");

	int rc = nrf_modem_lib_init();
	if (rc) {
		LOG_ERR("nrf_modem_lib_init: %d", rc);
		return 0;
	}

	/* The CA must be in the modem before LTE comes up. */
	size_t ca_len;
	const uint8_t *ca = runtime_zephyr_ca_pem(&ca_len);

	rc = install_ca(ca, ca_len);
	if (rc) {
		LOG_ERR("CA provisioning: %d", rc);
	}

	lte_led_init();

	/* LTE via the modem's Zephyr net_if: the monitor waits for its L4 event. */
	conn_mgr_all_if_up(true);
	conn_mgr_all_if_connect(true);

	int rc_cfg = read_cfg();

	if (rc_cfg < 0) {
		LOG_WRN("settings page unreadable or invalid: %d", rc_cfg);
	}

	static struct runtime_zephyr_sysinfo info = RUNTIME_ZEPHYR_SYSINFO_INIT;
	/* Custom id: from the settings page, else "nRF9151-DK_<FICR device id>"
	 * so the workshop boards tell apart on the platform. The library keeps
	 * the pointer, hence static.
	 */
	static char custom_id[RUNTIME_ZEPHYR_CUSTOM_ID_MAX + 1];

	if (cfg.custom_id[0]) {
		strcpy(custom_id, cfg.custom_id);
	} else {
		uint8_t devid[8];
		ssize_t n = hwinfo_get_device_id(devid, sizeof(devid));
		int off = snprintk(custom_id, sizeof(custom_id), "nRF9151-DK_");

		for (ssize_t i = 0; i < n; i++) {
			off += snprintk(custom_id + off, sizeof(custom_id) - off, "%02X", devid[i]);
		}
		if (n <= 0) {
			LOG_WRN("hwinfo_get_device_id: %d", (int)n);
			custom_id[0] = '\0';
		}
	}
	if (custom_id[0]) {
		info.custom_id = custom_id;
		LOG_INF("custom id %s", custom_id);
	}

	struct runtime_zephyr_connection conn = RUNTIME_ZEPHYR_CONNECTION_INIT;

	if (cfg.host[0]) {
		conn.host = cfg.host;
		conn.registration_host = cfg.host;
	}
	LOG_INF("platform %s (registration %s)", conn.host,
		conn.registration_host && conn.registration_host[0] ? conn.registration_host : conn.host);

	/* Token: from the settings page if the board has no identity yet,
	 * else CONFIG_RUNTIME_MONITOR_BOOTSTRAP_TOKEN (empty in this repo).
	 * The library still wants a non-empty token; without an identity the
	 * registration then fails and the monitor runs offline.
	 */
	bool token_from_flash = false;

	if (cfg.token[0] && has_identity()) {
		LOG_INF("board already has an identity; clearing the unused token");
		clear_cfg_token();
	} else if (cfg.token[0]) {
		LOG_INF("registering with the token from the settings page (%u chars)",
			(unsigned int)strlen(cfg.token));
		conn.bootstrap_token = cfg.token;
		token_from_flash = true;
	}
	if (conn.bootstrap_token == NULL || conn.bootstrap_token[0] == '\0') {
		conn.bootstrap_token = "no-token";
	}
	conn.creds = &creds;
	conn.sec_tag = SEC_TAG;

	/* Blocks until LTE + SNTP + (first boot) registration are done. */
	rc = runtime_zephyr_start(&info, &conn, NULL);
	if (rc) {
		LOG_ERR("runtime_zephyr_start: %d", rc);
	}
	if (token_from_flash) {
		clear_cfg_token();
		if (has_identity()) {
			LOG_INF("registered with the platform; token cleared");
		} else {
			LOG_ERR("registration failed; token cleared (tokens are single-use): "
				"flash a new settings page with a token");
		}
	}
	workload_start();

	k_sleep(K_FOREVER);
	return 0;
}
```

## src/app_workload.h
```c
#ifndef APP_WORKLOAD_H
#define APP_WORKLOAD_H

/* Wires Button 2 to a heap burst that triggers a HEAP_LOW incident. */
void workload_start(void);

#endif /* APP_WORKLOAD_H */
```
