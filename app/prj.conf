## CMakeLists.txt
```
cmake_minimum_required(VERSION 3.20.0)
find_package(Zephyr REQUIRED HINTS $ENV{ZEPHYR_BASE})
project(app)

# Only used when runtime-zephyr is built from source (blob rebuild, issue #4).
zephyr_include_directories(compat)

target_sources(app PRIVATE src/main.c src/app_workload.c)
```

## prj.conf
```kconfig
# --- nRF9151 / nuSIM LTE ---
CONFIG_BOOTLOADER_MCUBOOT=y

# --- Kernel ABI the blob was built against: must match it ---
# CONFIG_ASSERT turns on CONFIG_SPIN_VALIDATE, which makes struct k_spinlock
# (and with it struct k_msgq, k_sem, ...) 4 bytes larger. The blob's
# heap_msgq is laid out for CONFIG_ASSERT=y; without it k_msgq_put() runs
# off the end of the object and faults. overlay-nusim.conf sets it too;
# here it also holds for builds without the overlay. main.c checks
# sizeof(struct k_msgq).
CONFIG_ASSERT=y
CONFIG_LTE_LINK_CONTROL=y
CONFIG_NRF_MODEM_LIB=y

# --- zbus (required by the monitor's `depends on`) ---
CONFIG_ZBUS=y
CONFIG_ZBUS_MSG_SUBSCRIBER=y
CONFIG_ZBUS_MSG_SUBSCRIBER_BUF_ALLOC_STATIC=y
CONFIG_ZBUS_MSG_SUBSCRIBER_NET_BUF_POOL_SIZE=8
CONFIG_ZBUS_MSG_SUBSCRIBER_NET_BUF_STATIC_DATA_SIZE=192

# --- Runtime security monitor: built-in policies only (no LLEXT/syscall hooks) ---
# Feature set + tunables below are frozen into the blob (README: "Rebuilding the blob").
CONFIG_RUNTIME_MONITOR=y
# One policy per button (app_workload.c); platform.exein.io accepts all four.
CONFIG_POLICY_HEAP_LOW=y
CONFIG_POLICY_P2=y
CONFIG_POLICY_STACK_LOW=y
CONFIG_POLICY_LOG=y
# Button 3's stack_hog peaks at ~85% of its stack; the default 90 misses it.
CONFIG_THREAD_STACK_WARN_PCT=80
# nuSIM's softsim_req_han thread uses ~1130 B: with the 1280 B default it
# sits at ~88% and raises STACK_LOW every collect period. 2048 B keeps it
# near 55%.
CONFIG_LIB_NUSIM_STACK_SIZE=2048
# Button 4 leaks 160 x 32 B: 16-event windows x 8 = 128 events, 5 KB growth.
CONFIG_MEM_LEAK_WINDOW_EVENTS=16
CONFIG_THREAD_COLLECT_PERIOD_MS=2000
# Analyzer drains the heap event buffer every second; 5000 ms with a small
# buffer drops FREE events and wedges the HEAP_LOW live-bytes tally.
CONFIG_ANALYZER_PERIOD_MS=1000
CONFIG_MONITOR_EVENT_BUF_SIZE=16384
# The heap listener bridges alloc/free hooks through heap_msgq, drained every
# 500 ms. Default depth 16 silently drops any >16-event burst (Button 2 does
# 24 allocs + 24 frees); a dropped FREE permanently inflates the HEAP_LOW tally.
CONFIG_HEAP_MSGQ_DEPTH=512
# HEAP_LOW threshold: 60% of CONFIG_HEAP_MEM_POOL_SIZE (9831 B of 16 KB).
CONFIG_HEAP_LOW_PCT=60
CONFIG_THREAD_RUNTIME_STATS=y

# --- Exein platform over LTE (runtime_monitor_ncs.conf, modem TLS path) ---
# TLS runs in the modem; CA + client identity live in the modem key store
# (credential backend in main.c). No bootstrap token is built in: it comes
# from the settings page (web flasher or scripts/settings-hex.py).
CONFIG_THREAT_HTTP_DEST_ADDR="platform.exein.io"
CONFIG_THREAT_HTTP_PORT=8003
CONFIG_RUNTIME_MONITOR_REGISTRATION_ADDR="platform.exein.io"
CONFIG_RUNTIME_MONITOR_REGISTRATION_PORT=8004
# AT commands on the log UART (AT%XICCID health check, AT%CMNG to reset the identity).
CONFIG_AT_HOST_LIBRARY=y
CONFIG_UART_INTERRUPT_DRIVEN=y
CONFIG_NET_SOCKETS_SOCKOPT_TLS=n
CONFIG_RUNTIME_MONITOR_TLS=y
CONFIG_TLS_CREDENTIALS=y
CONFIG_MODEM_KEY_MGMT=y
CONFIG_RUNTIME_MONITOR_STACK_OVERFLOW=n
CONFIG_TFM_PARTITION_INTERNAL_TRUSTED_STORAGE=y
# The monitor waits for IPv4 via conn_mgr: needs the modem's Zephyr net_if.
CONFIG_NETWORKING=y
CONFIG_NET_SOCKETS=y
CONFIG_NET_IPV4=y
CONFIG_NET_IPV6=n
# Wall clock for the monitor (compat/zephyr/sys/clock.h on Zephyr 4.1).
CONFIG_POSIX_TIMERS=y
CONFIG_NET_CONNECTION_MANAGER=y
CONFIG_NRF_MODEM_LIB_NET_IF=y
# nuSIM LTE-M attach takes ~30 s; the 30 s default makes the monitor skip
# registration. Read by RUNTIME_ZEPHYR_CONNECTION_INIT (app side, not the blob).
CONFIG_RUNTIME_MONITOR_NET_CONNECT_TIMEOUT=180

# --- Settings page (web flasher or scripts/settings-hex.py; start of the unused MCUboot secondary slot) ---
CONFIG_FLASH=y
CONFIG_FLASH_MAP=y

# --- Custom id nRF9151-DK_<device id> in SystemInfo (main.c) ---
CONFIG_HWINFO=y

# --- Buttons 1-4 trigger the four incidents; LED1 shows LTE state ---
CONFIG_GPIO=y

# --- Resources ---
CONFIG_HEAP_MEM_POOL_SIZE=16384
CONFIG_MAIN_STACK_SIZE=8192

# --- Logging (UART) ---
CONFIG_LOG=y
CONFIG_LOG_DEFAULT_LEVEL=3
CONFIG_RUNTIME_MONITOR_LOG_LEVEL_DBG=y
CONFIG_UART_CONSOLE=y
CONFIG_LOG_BACKEND_UART=y
# Default 1 KB buffer drops lines at boot (monitor debug hex dumps).
CONFIG_LOG_BUFFER_SIZE=8192
```

## src/main.c
```c
/*
 * Exein Runtime Security Monitor on the nRF9151 DK.
 *
 * Runs the monitor (precompiled runtime-zephyr blob: HEAP_LOW, MEM_LEAK,
 * STACK_LOW and LOG policies) beside a button-driven demo workload (see app_workload.c). The monitor registers with the Exein platform over LTE and
 * posts incidents there; TLS runs in the modem, credentials live in the
 * modem's key store under SEC_TAG.
 */

#include <errno.h>
#include <string.h>
#include <zephyr/kernel.h>
#include <zephyr/logging/log.h>
#include <zephyr/drivers/gpio.h>
#include <zephyr/drivers/hwinfo.h>
#include <zephyr/net/conn_mgr_connectivity.h>
#include <zephyr/net/conn_mgr_monitor.h>
#include <zephyr/net/net_mgmt.h>
#include <zephyr/storage/flash_map.h>
#include <pm_config.h>
#include <modem/nrf_modem_lib.h>
#include <modem/lte_lc.h>
#include <modem/modem_key_mgmt.h>

#include <runtime_zephyr.h>
#include "app_workload.h"

LOG_MODULE_REGISTER(app, LOG_LEVEL_INF);

/* The blob's kernel objects (heap_msgq: 52 bytes) are laid out for the kernel
 * config it was built with, CONFIG_ASSERT=y among it (SPIN_VALIDATE grows
 * struct k_spinlock). A mismatch links fine and faults at runtime.
 */
BUILD_ASSERT(sizeof(struct k_msgq) == 52,
	     "struct k_msgq differs from the runtime-zephyr blob: set CONFIG_ASSERT=y");

/* ponytail: fixed modem sec_tag, make it a Kconfig if another app shares the modem. */
#define SEC_TAG 4242

/* Modem key-store writes need LTE off (CFUN=0 at boot, CFUN=4 later). */
static int write_cred(enum modem_key_mgmt_cred_type type, const uint8_t *buf, size_t len)
{
	return modem_key_mgmt_write(SEC_TAG, type, buf, len);
}

static int install_ca(const uint8_t *pem, size_t len)
{
	/* cmp() returns 0 when the stored CA equals pem. */
	if (modem_key_mgmt_cmp(SEC_TAG, MODEM_KEY_MGMT_CRED_TYPE_CA_CHAIN, pem, len) == 0) {
		return 0;
	}
	return write_cred(MODEM_KEY_MGMT_CRED_TYPE_CA_CHAIN, pem, len);
}

static int install_identity(const uint8_t *cert, size_t cert_len,
			    const uint8_t *key, size_t key_len)
{
	int rc = lte_lc_func_mode_set(LTE_LC_FUNC_MODE_OFFLINE);

	if (rc == 0) {
		rc = write_cred(MODEM_KEY_MGMT_CRED_TYPE_PUBLIC_CERT, cert, cert_len);
	}
	if (rc == 0) {
		rc = write_cred(MODEM_KEY_MGMT_CRED_TYPE_PRIVATE_CERT, key, key_len);
	}
	/* Back online either way; the net_if reconnects (connection persistence). */
	int rc2 = lte_lc_func_mode_set(LTE_LC_FUNC_MODE_NORMAL);

	return rc ? rc : rc2;
}

static bool has_identity(void)
{
	bool exists = false;

	(void)modem_key_mgmt_exists(SEC_TAG, MODEM_KEY_MGMT_CRED_TYPE_PRIVATE_CERT, &exists);
	return exists;
}

/* LTE status on LED1: blinking = no IPv4 connectivity, solid = connected.
 * (The nRF9151 DK LEDs are all green, so blink vs solid is the signal.)
 */
static const struct gpio_dt_spec lte_led = GPIO_DT_SPEC_GET(DT_ALIAS(led0), gpios);
static atomic_t lte_up;

static void lte_led_blink(struct k_work *work)
{
	if (atomic_get(&lte_up)) {
		gpio_pin_set_dt(&lte_led, 1);
		return;
	}
	gpio_pin_toggle_dt(&lte_led);
	k_work_schedule(k_work_delayable_from_work(work), K_MSEC(250));
}
static K_WORK_DELAYABLE_DEFINE(lte_led_work, lte_led_blink);

/* net_mgmt events are 64-bit since Zephyr 5a9a39caf3b (v4.2.0), 32-bit
 * before (NCS v3.1); NET_MGMT_MAX_COMMANDS came with that change.
 */
#ifdef NET_MGMT_MAX_COMMANDS
typedef uint64_t mgmt_event_t;
#else
typedef uint32_t mgmt_event_t;
#endif

static void l4_handler(struct net_mgmt_event_callback *cb, mgmt_event_t event,
		       struct net_if *iface)
{
	atomic_set(&lte_up, event == NET_EVENT_L4_IPV4_CONNECTED);
	k_work_reschedule(&lte_led_work, K_NO_WAIT);
}
static struct net_mgmt_event_callback l4_cb;

static void lte_led_init(void)
{
	if (gpio_pin_configure_dt(&lte_led, GPIO_OUTPUT_INACTIVE)) {
		return;
	}
	net_mgmt_init_event_callback(&l4_cb, l4_handler,
				     NET_EVENT_L4_IPV4_CONNECTED | NET_EVENT_L4_DISCONNECTED);
	net_mgmt_add_event_callback(&l4_cb);
	k_work_schedule(&lte_led_work, K_NO_WAIT);
}

/* Settings page (web flasher or scripts/settings-hex.py): a 4 KB page at the start of the
 * (unused) MCUboot secondary slot. The signed app image can't carry them
 * (MCUboot checks the signature on boot). Layout: "EXEINCFG", then three
 * NUL-terminated strings, each empty = keep the build's value:
 *   token      bootstrap token, used for one registration attempt and then
 *              cleared (the platform consumes a token even when the device
 *              fails to read the reply)
 *   custom id  SystemInfo custom_id (default nRF9151-DK_<device id>)
 *   host       platform host for registration (:8004) and telemetry (:8003)
 */
#define CFG_MAGIC "EXEINCFG"
#define CFG_MAGIC_LEN (sizeof(CFG_MAGIC) - 1)

static struct {
	char token[RUNTIME_ZEPHYR_TOKEN_MAX + 1];
	char custom_id[RUNTIME_ZEPHYR_CUSTOM_ID_MAX + 1];
	char host[RUNTIME_ZEPHYR_HOST_MAX + 1];
} cfg;

static const struct flash_area *cfg_area(void)
{
	const struct flash_area *fa;

	return flash_area_open(PM_MCUBOOT_SECONDARY_ID, &fa) ? NULL : fa;
}

/* Copies the next NUL-terminated string of buf[*off..len) into out. */
static int cfg_field(const char *buf, size_t len, size_t *off, char *out, size_t out_size)
{
	size_t n = strnlen(buf + *off, len - *off);

	if (n >= out_size || *off + n >= len) {
		return -EINVAL;
	}
	memcpy(out, buf + *off, n + 1);
	*off += n + 1;
	return 0;
}

/* 1 = settings loaded, 0 = no settings page, < 0 = error. */
static int read_cfg(void)
{
	const struct flash_area *fa = cfg_area();
	char buf[CFG_MAGIC_LEN + sizeof(cfg)];
	size_t off = CFG_MAGIC_LEN;

	if (fa == NULL || flash_area_read(fa, 0, buf, sizeof(buf))) {
		return -EIO;
	}
	if (memcmp(buf, CFG_MAGIC, CFG_MAGIC_LEN) != 0) {
		return 0;
	}
	if (cfg_field(buf, sizeof(buf), &off, cfg.token, sizeof(cfg.token)) ||
	    cfg_field(buf, sizeof(buf), &off, cfg.custom_id, sizeof(cfg.custom_id)) ||
	    cfg_field(buf, sizeof(buf), &off, cfg.host, sizeof(cfg.host))) {
		memset(&cfg, 0, sizeof(cfg));
		return -EINVAL;
	}
	return 1;
}

/* Rewrites the page without the token; custom id and host stay. */
static void clear_cfg_token(void)
{
	const struct flash_area *fa = cfg_area();
	uint8_t buf[ROUND_UP(CFG_MAGIC_LEN + sizeof(cfg), 4)];
	size_t off = CFG_MAGIC_LEN + 1; /* magic + empty token */

	memset(cfg.token, 0, sizeof(cfg.token));
	memset(buf, 0xff, sizeof(buf));
	memcpy(buf, CFG_MAGIC, CFG_MAGIC_LEN);
	buf[CFG_MAGIC_LEN] = '\0';
	strcpy((char *)buf + off, cfg.custom_id);
	off += strlen(cfg.custom_id) + 1;
	strcpy((char *)buf + off, cfg.host);
	off += strlen(cfg.host) + 1;
	if (fa == NULL || flash_area_erase(fa, 0, 4096) ||
	    flash_area_write(fa, 0, buf, ROUND_UP(off, 4))) {
		LOG_ERR("could not clear the token from the settings page");
	}
}

static const struct runtime_zephyr_cred_backend creds = {
	.install_ca = install_ca,
	.install_identity = install_identity,
	.has_identity = has_identity,
};

int main(void)
{
	k_thread_name_set(k_current_get(), "main");
	LOG_INF("Exein Runtime Monitor — nRF9151");

	int rc = nrf_modem_lib_init();
	if (rc) {
		LOG_ERR("nrf_modem_lib_init: %d", rc);
		return 0;
	}

	/* The CA must be in the modem before LTE comes up. */
	size_t ca_len;
	const uint8_t *ca = runtime_zephyr_ca_pem(&ca_len);

	rc = install_ca(ca, ca_len);
	if (rc) {
		LOG_ERR("CA provisioning: %d", rc);
	}

	int rc_cfg = read_cfg();

	if (rc_cfg < 0) {
		LOG_WRN("settings page unreadable or invalid: %d", rc_cfg);
	}

	/* A token on the settings page means "register (again)": delete the old
	 * identity, since the library only registers without one. Must happen
	 * here, while the modem is still offline (key store is read-only once
	 * LTE is up).
	 */
	if (cfg.token[0] && has_identity()) {
		int rc_pub = modem_key_mgmt_delete(SEC_TAG, MODEM_KEY_MGMT_CRED_TYPE_PUBLIC_CERT);
		int rc_key = modem_key_mgmt_delete(SEC_TAG, MODEM_KEY_MGMT_CRED_TYPE_PRIVATE_CERT);

		if (has_identity()) {
			LOG_ERR("could not delete the old identity (%d, %d)", rc_pub, rc_key);
		} else {
			LOG_INF("new token on the settings page; old identity deleted");
		}
	}

	lte_led_init();

	/* LTE via the modem's Zephyr net_if: the monitor waits for its L4 event. */
	conn_mgr_all_if_up(true);
	conn_mgr_all_if_connect(true);

	static struct runtime_zephyr_sysinfo info = RUNTIME_ZEPHYR_SYSINFO_INIT;
	/* Custom id: from the settings page, else "nRF9151-DK_<FICR device id>"
	 * so the workshop boards tell apart on the platform. The library keeps
	 * the pointer, hence static.
	 */
	static char custom_id[RUNTIME_ZEPHYR_CUSTOM_ID_MAX + 1];

	if (cfg.custom_id[0]) {
		strcpy(custom_id, cfg.custom_id);
	} else {
		uint8_t devid[8];
		ssize_t n = hwinfo_get_device_id(devid, sizeof(devid));
		int off = snprintk(custom_id, sizeof(custom_id), "nRF9151-DK_");

		for (ssize_t i = 0; i < n; i++) {
			off += snprintk(custom_id + off, sizeof(custom_id) - off, "%02X", devid[i]);
		}
		if (n <= 0) {
			LOG_WRN("hwinfo_get_device_id: %d", (int)n);
			custom_id[0] = '\0';
		}
	}
	if (custom_id[0]) {
		info.custom_id = custom_id;
		LOG_INF("custom id %s", custom_id);
	}

	struct runtime_zephyr_connection conn = RUNTIME_ZEPHYR_CONNECTION_INIT;

	if (cfg.host[0]) {
		conn.host = cfg.host;
		conn.registration_host = cfg.host;
	}
	LOG_INF("platform %s (registration %s)", conn.host,
		conn.registration_host && conn.registration_host[0] ? conn.registration_host : conn.host);

	/* Token: from the settings page (old identity deleted above), else
	 * CONFIG_RUNTIME_MONITOR_BOOTSTRAP_TOKEN (empty in this repo). The
	 * library still wants a non-empty token; without an identity the
	 * registration then fails and the monitor runs offline.
	 */
	bool token_from_flash = false;

	if (cfg.token[0]) {
		LOG_INF("registering with the token from the settings page (%u chars)",
			(unsigned int)strlen(cfg.token));
		conn.bootstrap_token = cfg.token;
		token_from_flash = true;
	}
	if (conn.bootstrap_token == NULL || conn.bootstrap_token[0] == '\0') {
		conn.bootstrap_token = "no-token";
	}
	conn.creds = &creds;
	conn.sec_tag = SEC_TAG;

	/* Blocks until LTE + SNTP + (first boot) registration are done. */
	rc = runtime_zephyr_start(&info, &conn, NULL);
	if (rc) {
		LOG_ERR("runtime_zephyr_start: %d", rc);
	}
	if (token_from_flash) {
		clear_cfg_token();
		if (has_identity()) {
			LOG_INF("registered with the platform; token cleared");
		} else {
			LOG_ERR("registration failed; token cleared (tokens are single-use): "
				"flash a new settings page with a token");
		}
	}
	workload_start();

	k_sleep(K_FOREVER);
	return 0;
}
```

## src/app_workload.c
```c
/*
 * Demo workload for the Exein Runtime Security Monitor: one button per
 * incident type.
 *
 *   Button 1  5 identical LOG_ERR            -> Log Event (one incident)
 *   Button 2  burst past 60% of the heap     -> Heap Exhaustion
 *   Button 3  thread "stack_hog" at ~90%     -> Free Stack Below Critical Threshold
 *   Button 4  slow sustained heap growth     -> Memory Leak
 *
 * Every trigger cleans up after itself (memory freed, thread exits), so the
 * demo is repeatable.
 */

#include <zephyr/kernel.h>
#include <zephyr/logging/log.h>
#include <zephyr/drivers/gpio.h>

#include "app_workload.h"

LOG_MODULE_REGISTER(workload, LOG_LEVEL_INF);

/* ── Button 1: Log Event ─────────────────────────────────────────── */

/* Identical errors in one reporting interval become a single incident. */
#define LOG_REPEAT 5

static void log_burst_work(struct k_work *w)
{
	ARG_UNUSED(w);
	for (int i = 0; i < LOG_REPEAT; i++) {
		LOG_ERR("sensor read failed: -5");
	}
}
static K_WORK_DEFINE(log_burst, log_burst_work);

/* ── Button 2: Heap Exhaustion ───────────────────────────────────── */

/* The analyzer checks HEAP_LOW once per CONFIG_ANALYZER_PERIOD_MS, after
 * replaying the alloc/free events of that period: memory freed within the
 * same period never shows up. Holding it for two periods always does.
 */
#define HOLD_MS (2 * CONFIG_ANALYZER_PERIOD_MS)

static void *held[24];
static int held_n;

static void heap_free_work(struct k_work *w)
{
	ARG_UNUSED(w);
	while (held_n > 0) {
		k_free(held[--held_n]);
	}
}
static K_WORK_DELAYABLE_DEFINE(heap_free, heap_free_work);

static void heap_burst_work(struct k_work *w)
{
	ARG_UNUSED(w);
	if (held_n > 0) {
		return; /* previous burst still held */
	}
	while (held_n < ARRAY_SIZE(held) && (held[held_n] = k_malloc(512)) != NULL) {
		held_n++;
	}
	LOG_WRN("BTN2: burst-allocated %d x 512 B, freeing in %d ms (expect HEAP_LOW)",
		held_n, HOLD_MS);
	k_work_schedule(&heap_free, K_MSEC(HOLD_MS));
}
static K_WORK_DEFINE(heap_burst, heap_burst_work);

/* ── Button 3: Stack Overflow Risk ───────────────────────────────── */

/* A dedicated thread recurses until STACK_HOG_PCT of its stack is used, then
 * stays alive for STACK_HOG_HOLD_S so the collector (THREAD_COLLECT_PERIOD_MS,
 * 2 s) samples it at least once, then exits. Shorter than the alert cooldown
 * (ALERT_COOLDOWN_MS, 5 s): one press, one incident. A 20 s hold raised one
 * incident per flush window, four per press. Must stay above CONFIG_THREAD_STACK_WARN_PCT and
 * below 100: a real overflow halts the board. Its own thread, because the
 * high-water mark of the system workqueue would stay high forever.
 */
#define STACK_HOG_SIZE   1024
#define STACK_HOG_PCT    90
#define STACK_HOG_HOLD_S 3

K_THREAD_STACK_DEFINE(hog_stack, STACK_HOG_SIZE);
static struct k_thread hog_thread;
static atomic_t hog_busy;

static size_t stack_used(void)
{
	const struct k_thread *t = k_current_get();
	volatile char here;

	return t->stack_info.start + t->stack_info.size - (uintptr_t)&here;
}

__attribute__((noinline))
static void deep_recurse(size_t target)
{
	volatile char pad[64];

	pad[0] = 0;
	if (stack_used() < target) {
		deep_recurse(target);
	}
	pad[63] = pad[0];
}

static void stack_hog_entry(void *p1, void *p2, void *p3)
{
	ARG_UNUSED(p1);
	ARG_UNUSED(p2);
	ARG_UNUSED(p3);

	/* One frame of headroom: the check runs before the next 64 B pad. */
	deep_recurse(k_current_get()->stack_info.size * STACK_HOG_PCT / 100 - 96);
	LOG_WRN("BTN3: stack_hog near its stack limit for %d s (expect STACK_LOW)",
		STACK_HOG_HOLD_S);
	k_sleep(K_SECONDS(STACK_HOG_HOLD_S));
	atomic_clear(&hog_busy);
}

static void stack_hog_work(struct k_work *w)
{
	ARG_UNUSED(w);
	if (!atomic_cas(&hog_busy, 0, 1)) {
		return; /* previous stack_hog still running */
	}
	k_thread_create(&hog_thread, hog_stack, K_THREAD_STACK_SIZEOF(hog_stack),
			stack_hog_entry, NULL, NULL, NULL, 8, 0, K_NO_WAIT);
	k_thread_name_set(&hog_thread, "stack_hog");
}
static K_WORK_DEFINE(stack_hog, stack_hog_work);

/* ── Button 4: Memory Leak ───────────────────────────────────────── */

/* One unfreed block every LEAK_PACE_MS, so every leak window
 * (CONFIG_MEM_LEAK_WINDOW_EVENTS heap events) grows. LEAK_N blocks span more
 * than the 8 windows the policy needs and exceed MEM_LEAK_MIN_NET_GROWTH
 * (4096 B), while staying below the 60% HEAP_LOW threshold of the 16 KB heap.
 * Freed again after HOLD_MS.
 */
#define LEAK_N       160
#define LEAK_SIZE    32
#define LEAK_PACE_MS 100

static void *leaked[LEAK_N];
static int leak_n;
static bool leak_busy;

static void leak_free_work(struct k_work *w)
{
	ARG_UNUSED(w);
	while (leak_n > 0) {
		k_free(leaked[--leak_n]);
	}
	leak_busy = false;
}
static K_WORK_DELAYABLE_DEFINE(leak_free, leak_free_work);

static void leak_step_work(struct k_work *w);
static K_WORK_DELAYABLE_DEFINE(leak_step, leak_step_work);

static void leak_step_work(struct k_work *w)
{
	ARG_UNUSED(w);
	if (leak_n < LEAK_N && (leaked[leak_n] = k_malloc(LEAK_SIZE)) != NULL) {
		leak_n++;
		k_work_schedule(&leak_step, K_MSEC(LEAK_PACE_MS));
		return;
	}
	LOG_WRN("BTN4: leaked %d x %d B, freeing in %d ms (expect MEM_LEAK)",
		leak_n, LEAK_SIZE, HOLD_MS);
	k_work_schedule(&leak_free, K_MSEC(HOLD_MS));
}

static void leak_start_work(struct k_work *w)
{
	ARG_UNUSED(w);
	if (leak_busy) {
		return; /* previous leak still running or held */
	}
	leak_busy = true;
	LOG_WRN("BTN4: leaking %d x %d B over %d s", LEAK_N, LEAK_SIZE,
		LEAK_N * LEAK_PACE_MS / 1000);
	k_work_schedule(&leak_step, K_NO_WAIT);
}
static K_WORK_DEFINE(leak_start, leak_start_work);

/* ── Buttons ─────────────────────────────────────────────────────── */

static const struct gpio_dt_spec btns[] = {
	GPIO_DT_SPEC_GET(DT_ALIAS(sw0), gpios),
	GPIO_DT_SPEC_GET(DT_ALIAS(sw1), gpios),
	GPIO_DT_SPEC_GET(DT_ALIAS(sw2), gpios),
	GPIO_DT_SPEC_GET(DT_ALIAS(sw3), gpios),
};
/* k_malloc and thread creation are not ISR work: hand off to the workqueue. */
static struct k_work *const actions[] = { &log_burst, &heap_burst, &stack_hog, &leak_start };
static struct gpio_callback btn_cb[ARRAY_SIZE(btns)];

static void btn_pressed(const struct device *d, struct gpio_callback *cb, uint32_t pins)
{
	ARG_UNUSED(d);
	ARG_UNUSED(pins);
	k_work_submit(actions[cb - btn_cb]);
}

void workload_start(void)
{
	for (int i = 0; i < ARRAY_SIZE(btns); i++) {
		if (!gpio_is_ready_dt(&btns[i])) {
			LOG_ERR("button %d not ready", i + 1);
			continue;
		}
		gpio_pin_configure_dt(&btns[i], GPIO_INPUT);
		gpio_pin_interrupt_configure_dt(&btns[i], GPIO_INT_EDGE_TO_ACTIVE);
		gpio_init_callback(&btn_cb[i], btn_pressed, BIT(btns[i].pin));
		gpio_add_callback(btns[i].port, &btn_cb[i]);
	}
	LOG_INF("Buttons: 1 Log Event, 2 Heap Exhaustion, 3 Stack Overflow Risk, 4 Memory Leak");
}
```

## src/app_workload.h
```c
#ifndef APP_WORKLOAD_H
#define APP_WORKLOAD_H

/* Wires Buttons 1-4 to Log Event, Heap Exhaustion, Stack Overflow Risk and
 * Memory Leak triggers. */
void workload_start(void);

#endif /* APP_WORKLOAD_H */
```
